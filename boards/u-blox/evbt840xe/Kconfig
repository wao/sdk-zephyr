## boards/u-blox/evbt840xe/Kconfig
```kconfig
# BMD-340-EVAL board configuration

# Copyright (c) 2021 u-blox AG
# SPDX-License-Identifier: Apache-2.0

config BOARD_ENABLE_DCDC
	bool "DCDC mode"
	select SOC_DCDC_NRF52X
	default y
	depends on BOARD_EVBT840XE

config BOARD_ENABLE_DCDC_HV
	bool "High Voltage DCDC converter"
	select SOC_DCDC_NRF52X_HV
	default y
	depends on BOARD_EVBT840XE
```

## boards/u-blox/evbt840xe/Kconfig.defconfig
```kconfig
# BMD-340-EVAL board configuration

# Copyright (c) 2021 u-blox AG
# SPDX-License-Identifier: Apache-2.0

if BOARD_EVBT840XE

config BT_CTLR
	default BT

endif # BOARD_UBX_BMD340EVAL
```
