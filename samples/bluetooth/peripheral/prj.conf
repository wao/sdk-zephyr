## CMakeLists.txt
```
# SPDX-License-Identifier: Apache-2.0

cmake_minimum_required(VERSION 3.20.0)
find_package(Zephyr REQUIRED HINTS $ENV{ZEPHYR_BASE})
project(peripheral)

target_sources(app PRIVATE
  src/main.c
  src/led.c
  src/nvsfs.c
  src/bat.c
)
```

## prj.conf
```kconfig
# Increased stack due to settings API usage
CONFIG_SYSTEM_WORKQUEUE_STACK_SIZE=768

CONFIG_BT=y
CONFIG_LOG=y
#CONFIG_BT_SMP=y
#CONFIG_BT_SIGNING=y
CONFIG_BT_PERIPHERAL=y
CONFIG_BT_DIS=y
CONFIG_BT_ATT_PREPARE_COUNT=5
CONFIG_BT_BAS=y
CONFIG_ADC=y 
#CONFIG_BT_HRS=y
#CONFIG_BT_IAS=y
#CONFIG_BT_PRIVACY=y
CONFIG_BT_DEVICE_NAME="PTT-Z-YA01"
CONFIG_BT_DEVICE_APPEARANCE=833
CONFIG_BT_DEVICE_NAME_DYNAMIC=y
CONFIG_BT_DEVICE_NAME_MAX=65
CONFIG_BT_FILTER_ACCEPT_LIST=y

#CONFIG_BT_KEYS_OVERWRITE_OLDEST=y
#CONFIG_BT_SETTINGS=y
#CONFIG_FLASH=y
#CONFIG_FLASH_MAP=y
#CONFIG_NVS=y
#CONFIG_SETTINGS=y

CONFIG_DEBUG=y
CONFIG_DEBUG_INFO=y
CONFIG_DEBUG_OPTIMIZATIONS=y
CONFIG_THREAD_ANALYZER=y
CONFIG_THREAD_NAME=y
CONFIG_CONSOLE=n
CONFIG_RTT_CONSOLE=n
CONFIG_USE_SEGGER_RTT=y
CONFIG_LOG_BACKEND_RTT=y
CONFIG_LOG_BACKEND_UART=n
CONFIG_LOG_BACKEND_RTT_MODE_BLOCK=y
CONFIG_CONSOLE=n
CONFIG_UART_CONSOLE=n
CONFIG_STDOUT_CONSOLE=n
CONFIG_FPU=y
CONFIG_MAIN_STACK_SIZE=1024
CONFIG_ISR_STACK_SIZE=896

CONFIG_SPI=n
CONFIG_SERIAL=n
CONFIG_FLASH=y
CONFIG_I2C=n
CONFIG_GPIO=y
CONFIG_LED=y
CONFIG_NVS=y

CONFIG_SETTINGS=n
CONFIG_BT_LONG_WQ=n
```

## src/main.c
```c
/* main.c - Application main entry point */

/*
 * Copyright (c) 2015-2016 Intel Corporation
 *
 * SPDX-License-Identifier: Apache-2.0
 */

#include <zephyr/types.h>
#include <stddef.h>
#include <string.h>
#include <errno.h>
#include <zephyr/sys/printk.h>
#include <zephyr/sys/byteorder.h>
#include <zephyr/kernel.h>

//#include <zephyr/settings/settings.h>

#include <zephyr/bluetooth/bluetooth.h>
#include <zephyr/bluetooth/hci.h>
#include <zephyr/bluetooth/conn.h>
#include <zephyr/bluetooth/uuid.h>
#include <zephyr/bluetooth/gatt.h>
#include <zephyr/bluetooth/services/bas.h>
//#include <zephyr/bluetooth/services/hrs.h>
#include <zephyr/bluetooth/services/ias.h>
#include <zephyr/drivers/gpio.h>
#include <zephyr/debug/thread_analyzer.h>
#include "led.h"
#include "bat.h"
#include "zephyr/bluetooth/hci_types.h"

#include <zephyr/logging/log.h>
LOG_MODULE_REGISTER(blekey, LOG_LEVEL_DBG);


/* Custom Service Variables */
#define BT_UUID_CUSTOM_SERVICE_VAL 0xFFE0

//static const struct bt_uuid_128 vnd_uuid = BT_UUID_INIT_128(
//	BT_UUID_CUSTOM_SERVICE_VAL);
static const struct bt_uuid_16 vnd_uuid = BT_UUID_INIT_16(BT_UUID_CUSTOM_SERVICE_VAL);

static const struct bt_uuid_16 vnd_enc_uuid = BT_UUID_INIT_16(0xFFE1);
static const struct bt_uuid_16 vnd_enc2_uuid = BT_UUID_INIT_16(0xFFE3);

#define VND_MAX_LEN 1

static uint8_t vnd_value[1] = {0};
static uint8_t vnd2_value[1] = {0};

static ssize_t read_vnd(struct bt_conn *conn, const struct bt_gatt_attr *attr,
			void *buf, uint16_t len, uint16_t offset)
{
	const char *value = attr->user_data;

  LOG_INF("read_vnd");

	return bt_gatt_attr_read(conn, attr, buf, len, offset, value,
				 1);
}

static ssize_t write_vnd(struct bt_conn *conn, const struct bt_gatt_attr *attr,
			 const void *buf, uint16_t len, uint16_t offset,
			 uint8_t flags)
{
	uint8_t *value = attr->user_data;
  LOG_INF("write_vnd");

	if (offset + len > VND_MAX_LEN) {
		return BT_GATT_ERR(BT_ATT_ERR_INVALID_OFFSET);
	}

	memcpy(value + offset, buf, len);
	value[offset + len] = 0;

	return len;
}

static void vnd_ccc_cfg_changed(const struct bt_gatt_attr *attr, uint16_t value)
{
  LOG_INF("ccc changed %d", value);
}

static void vnd2_ccc_cfg_changed(const struct bt_gatt_attr *attr, uint16_t value)
{
  LOG_INF("ccc2 changed %d", value);
}

/* Vendor Primary Service Declaration */
BT_GATT_SERVICE_DEFINE(vnd_svc,
	BT_GATT_PRIMARY_SERVICE(&vnd_uuid),
	BT_GATT_CHARACTERISTIC(&vnd_enc2_uuid.uuid,
			       BT_GATT_CHRC_READ | 
			       //BT_GATT_CHRC_WRITE | 
			       BT_GATT_CHRC_NOTIFY,
			       BT_GATT_PERM_READ,
             //|
			       //BT_GATT_PERM_WRITE,
			       read_vnd, write_vnd, vnd2_value),
	BT_GATT_CCC(vnd2_ccc_cfg_changed,
		    BT_GATT_PERM_READ | BT_GATT_PERM_WRITE),
  //For a defact in Y6000 code, this character must be in last one in services list
	BT_GATT_CHARACTERISTIC(&vnd_enc_uuid.uuid,
			       BT_GATT_CHRC_READ | 
			       //BT_GATT_CHRC_WRITE | 
			       BT_GATT_CHRC_NOTIFY,
			       BT_GATT_PERM_READ,
             //|
			       //BT_GATT_PERM_WRITE,
			       read_vnd, write_vnd, vnd_value),
	BT_GATT_CCC(vnd_ccc_cfg_changed,
		    BT_GATT_PERM_READ | BT_GATT_PERM_WRITE),
);

static const struct bt_data ad[] = {
	BT_DATA_BYTES(BT_DATA_FLAGS, (BT_LE_AD_GENERAL | BT_LE_AD_NO_BREDR)),
	BT_DATA_BYTES(BT_DATA_UUID16_ALL,
           BT_UUID_16_ENCODE(BT_UUID_BAS_VAL),
		      BT_UUID_16_ENCODE(BT_UUID_CUSTOM_SERVICE_VAL)),
};

static const struct bt_data sd[] = {
	BT_DATA(BT_DATA_NAME_COMPLETE, CONFIG_BT_DEVICE_NAME, sizeof(CONFIG_BT_DEVICE_NAME) - 1),
};

void mtu_updated(struct bt_conn *conn, uint16_t tx, uint16_t rx)
{
	LOG_INF("Updated MTU: TX: %d RX: %d bytes\n", tx, rx);
}

static struct bt_gatt_cb gatt_callbacks = {
	.att_mtu_updated = mtu_updated
};


struct bt_conn_info info;
static bool s_connected = false;
static bt_addr_le_t addr = { 0, { 0xfc, 0xdb, 0x20, 0x6a, 0x70, 0x20 }};

static void dump_conn_info(){
  if(s_connected){
      char le_addr[BT_ADDR_LE_STR_LEN];
      bt_addr_le_to_str(info.le.remote, le_addr, sizeof(le_addr));
      uint8_t * ap = &(info.le.remote->a.val);
      LOG_INF("Connected to %s 0x%x - 0x%0x%0x%0x%0x%0x%0x\n", le_addr, info.le.remote->type, *ap, *(ap+1), *(ap+2), *(ap+3), *(ap+4), *(ap+5));
  }
}

static void connected(struct bt_conn *conn, uint8_t err)
{
	if (err) {
		LOG_INF("Connection failed (err 0x%02x)\n", err);
	} else {
    led_set(LED_SLOW_FLASH);

    bt_conn_get_info(conn, &info);
    s_connected = true;
    dump_conn_info();

#if 0
    if (!bt_addr_le_eq(&addr, info.le.remote)) {
      LOG_ERR("Not expected device, reject connection");
      int ret = bt_conn_disconnect(conn, BT_HCI_ERR_REMOTE_USER_TERM_CONN );
      if (ret) {
        LOG_INF("Disconnecting failed to (err %d)\n", ret);
        return;
      }
    }
#endif
  } 
}

static void disconnected(struct bt_conn *conn, uint8_t reason)
{
  s_connected = false;
  led_set(LED_OFF);
	LOG_INF("Disconnected (reason 0x%02x)\n", reason);
}

static void alert_stop(void)
{
	LOG_INF("Alert stopped\n");
}

static void alert_start(void)
{
	LOG_INF("Mild alert started\n");
}

static void alert_high_start(void)
{
	LOG_INF("High alert started\n");
}

BT_CONN_CB_DEFINE(conn_callbacks) = {
	.connected = connected,
	.disconnected = disconnected,
};

BT_IAS_CB_DEFINE(ias_callbacks) = {
	.no_alert = alert_stop,
	.mild_alert = alert_start,
	.high_alert = alert_high_start,
};

static void bt_ready(void)
{
	int err;

	LOG_INF("Bluetooth initialized\n");

	//cts_init();

	//if (IS_ENABLED(CONFIG_SETTINGS)) {
//		settings_load();
	//}
	err = bt_le_adv_start(BT_LE_ADV_CONN, ad, ARRAY_SIZE(ad), sd, ARRAY_SIZE(sd));
	if (err) {
		LOG_INF("Advertising failed to start (err %d)\n", err);
		return;
	}

	LOG_INF("Advertising successfully started\n");
}

static void auth_passkey_display(struct bt_conn *conn, unsigned int passkey)
{
	char addr[BT_ADDR_LE_STR_LEN];

	bt_addr_le_to_str(bt_conn_get_dst(conn), addr, sizeof(addr));

	LOG_INF("Passkey for %s: %06u\n", addr, passkey);
}

static void auth_cancel(struct bt_conn *conn)
{
	char addr[BT_ADDR_LE_STR_LEN];

	bt_addr_le_to_str(bt_conn_get_dst(conn), addr, sizeof(addr));

	LOG_INF("Pairing cancelled: %s\n", addr);
}

#if 0
static struct bt_conn_auth_cb auth_cb_display = {
	.passkey_display = auth_passkey_display,
	.passkey_entry = NULL,
	.cancel = auth_cancel,
};

static void bas_notify(void)
{
	uint8_t battery_level = bt_bas_get_battery_level();

	battery_level--;

	if (!battery_level) {
		battery_level = 100U;
	}

	bt_bas_set_battery_level(battery_level);
}

static void hrs_notify(void)
{
	static uint8_t heartrate = 90U;

	/* Heartrate measurements simulation */
	heartrate++;
	if (heartrate == 160U) {
		heartrate = 90U;
	}

	bt_hrs_notify(heartrate);
}
#endif


typedef struct _gpio_key_control {
  struct gpio_dt_spec key;
  struct gpio_callback cb;
} gpio_key_control;

gpio_key_control key1 =  { .key = GPIO_DT_SPEC_GET(DT_NODELABEL(key1), gpios) };

gpio_key_control sw_keys[] = {
  { .key = GPIO_DT_SPEC_GET(DT_NODELABEL(sw1), gpios) },
  { .key = GPIO_DT_SPEC_GET(DT_NODELABEL(sw2), gpios) },
  { .key = GPIO_DT_SPEC_GET(DT_NODELABEL(sw3), gpios) },
  { .key = GPIO_DT_SPEC_GET(DT_NODELABEL(key2), gpios) },
};

const struct gpio_dt_spec sw_output_gpio = GPIO_DT_SPEC_GET(DT_PATH(zephyr_user), sw_output_gpios);

K_SEM_DEFINE(key1_sem, 0, 4);

void key1_pressed(const struct device *dev, struct gpio_callback *cb,
		    uint32_t pins)
{
	LOG_INF("Button pressed at %" PRIu32 "\n", k_cycle_get_32());
  k_sem_give(&key1_sem);
}


void config_key_control(gpio_key_control * key)
{
  int ret = gpio_pin_configure_dt(&key->key, GPIO_INPUT);
	if (ret != 0) {
		LOG_ERR("Error %d: failed to configure %s pin %d\n",
		       ret, key->key.port->name, key->key.pin);
    return;
	}

  ret = gpio_pin_interrupt_configure_dt(&key->key,
					      GPIO_INT_EDGE_BOTH);
	if (ret != 0) {
		LOG_ERR("Error %d: failed to configure interrupt on %s pin %d\n",
			ret, key->key.port->name, key->key.pin);
    return;
	}

	gpio_init_callback(&key->cb, key1_pressed, BIT(key->key.pin));
	gpio_add_callback(key->key.port, &key->cb);
	LOG_INF("Set up button at %s pin %d\n", key->key.port->name, key->key.pin);
}

#define SW_KEY_NUM 4

void config_sw_keys(void){
  int ret = gpio_pin_configure_dt(&sw_output_gpio, GPIO_OUTPUT);
	if (ret != 0) {
		LOG_ERR("Error %d: failed to configure %s pin %d\n",
		       ret, sw_output_gpio.port->name, sw_output_gpio.pin);
    return;
	}

  gpio_pin_set_dt(&sw_output_gpio, 1);

  for( int i = 0; i < SW_KEY_NUM; ++i ){
    config_key_control(&sw_keys[i]);
  }
}

static int update_count = 0;


void update_key1_value(uint8_t value) {
    vnd_value[0] = value;
    LOG_INF("Bluetooth run %d %d", update_count, vnd_value[0]);
    bt_gatt_notify(NULL, &vnd_svc.attrs[5], vnd_value, 1);
    if (value == 0) {
      led_restore();
    } else {
      led_set(LED_ON);
    }
}

void update_sw_value(uint8_t value) {
    vnd2_value[0] = value;
    LOG_INF("Bluetooth run %d %d", update_count, vnd2_value[0]);
    bt_gatt_notify(NULL, &vnd_svc.attrs[1], vnd2_value, 1);
}

static uint8_t key1_value = 0;
static uint8_t sw_value[] = { 0, 0, 0, 0 };

uint8_t cacluate_sw_value(void) {
  uint8_t ret = 0;
  for(int i = 0; i < SW_KEY_NUM; ++i){
    ret = 2 * ret + sw_value[SW_KEY_NUM-1-i];
  }
  return ret;
}

uint8_t read_sw_value(void){
  for( int i = 0; i < SW_KEY_NUM; ++i ){
    sw_value[i] = gpio_pin_get_dt(&sw_keys[i].key);
  }

  return cacluate_sw_value();
}

enum {
  P0_MV = 2000,
  P33_MV = 2600,
  P100_MV = 2900,
};

int bat_to_percent(int mv) {
  if (mv > P100_MV) {
    return 100;
  } else {
    if ( mv > P33_MV ) {
      return (mv - P33_MV) * 66 / (P100_MV - P33_MV) + 33;
    } else {
      if ( mv > P0_MV ){
        return (mv - P0_MV) * 33 / (P33_MV - P0_MV);
      } else {
        return 0;
      }
    }
  }
}

void bas_notify() {
  int bat_mv = bat_read();
  int bat_level = bat_to_percent( bat_mv );
  LOG_INF("Battery %d mv as %d%", bat_mv, bat_level);
  bt_bas_set_battery_level( bat_level );
}


int main(void)
{
	struct bt_gatt_attr *vnd_ind_attr;
	char str[BT_UUID_STR_LEN];
	int err;

  led_init();
  config_key_control(&key1);
  config_sw_keys();

  led_set(LED_OFF);
  k_sem_take(&key1_sem, K_FOREVER);

  bat_init();

	err = bt_enable(NULL);
	if (err) {
		LOG_INF("Bluetooth init failed (err %d)\n", err);
		return 0;
	}

	bt_ready();

	bt_gatt_cb_register(&gatt_callbacks);
	//bt_conn_auth_cb_register(&auth_cb_display);

	vnd_ind_attr = bt_gatt_find_by_uuid(vnd_svc.attrs, vnd_svc.attr_count,
					    &vnd_enc_uuid.uuid);
	bt_uuid_to_str(&vnd_enc_uuid.uuid, str, sizeof(str));
	LOG_INF("Indicate VND attr %p (UUID %s)\n", vnd_ind_attr, str);

  bas_notify();

	/* Implement notification. At the moment there is no suitable way
	 * of starting delayed work so we do it here
	 */

  update_key1_value(key1_value);
  update_sw_value(read_sw_value());
  led_set(LED_QUICK_FLASH);
  bas_notify();
  
	while (1) {
    k_sem_take(&key1_sem, K_FOREVER);
    update_count ++;
    dump_conn_info();
    bas_notify();

		/* Current Time Service updates only when time is changed */
		//cts_notify();

		/* Heartrate measurements simulation */
		//hrs_notify();

		/* Battery level simulation */
		//bas_notify();

    key1_value = gpio_pin_get_dt(&key1.key);
    if( key1_value != vnd_value[0] ){
      update_key1_value(key1_value);
    }
    {
      uint8_t sw_value = read_sw_value();
      if (sw_value != vnd2_value[0]) {
        update_sw_value(sw_value);
      }
    }
    thread_analyzer_print();
	}
	return 0;
}
```

## src/bat.c
```c
#include <zephyr/init.h>
#include <zephyr/kernel.h>
#include <zephyr/drivers/gpio.h>
#include <zephyr/drivers/adc.h>
#include "bat.h"

#include <zephyr/logging/log.h>
LOG_MODULE_REGISTER(bat, LOG_LEVEL_DBG);

#if !DT_NODE_EXISTS(DT_PATH(zephyr_user)) || \
	!DT_NODE_HAS_PROP(DT_PATH(zephyr_user), io_channels)
#error "No suitable devicetree overlay specified"
#endif

#define DT_SPEC_AND_COMMA(node_id, prop, idx) \
	ADC_DT_SPEC_GET_BY_IDX(node_id, idx),

/* Data of ADC io-channels specified in devicetree. */
static const struct adc_dt_spec adc_channels[] = {
	DT_FOREACH_PROP_ELEM(DT_PATH(zephyr_user), io_channels,
			     DT_SPEC_AND_COMMA)
};

void bat_init(void) {
  int err;

  if (!adc_is_ready_dt(&adc_channels[0])) {
    LOG_ERR("Battery adc %s is not ready", adc_channels[0].dev->name); 
    return;
  }

  err = adc_channel_setup_dt(&adc_channels[0]);
  if (err<0) {
    LOG_ERR("Set up battery adc channel error %d", err);
  }
}

int bat_read(void) {
  int err;
  int32_t val_mv;
	uint16_t buf;
	struct adc_sequence sequence = {
		.buffer = &buf,
		/* buffer size in bytes, not number of samples */
		.buffer_size = sizeof(buf),
	};

		(void)adc_sequence_init_dt(&adc_channels[0], &sequence);

			err = adc_read_dt(&adc_channels[0], &sequence);
			if (err < 0) {
				LOG_ERR("Could not read (%d)\n", err);
        return err;
			}

			/*
			 * If using differential mode, the 16 bit value
			 * in the ADC sample buffer should be a signed 2's
			 * complement value.
			 */
			if (adc_channels[0].channel_cfg.differential) {
				val_mv = (int32_t)((int16_t)buf);
			} else {
				val_mv = (int32_t)buf;
			}
      LOG_INF("%"PRId32, val_mv);
			err = adc_raw_to_millivolts_dt(&adc_channels[0],
						       &val_mv);
			/* conversion to mV may not be supported, skip if not */
			if (err < 0) {
				LOG_ERR(" (value in mV not available)\n");
			} else {
				LOG_INF(" = %"PRId32" mV\n", val_mv);
			}
      return val_mv;
}
```

## src/bat.h
```c
#ifndef __BAT_H
#define __BAT_H

void bat_init(void);
int bat_read(void);

#endif
```

## src/led.c
```c
#include <zephyr/drivers/gpio.h>
#include <zephyr/kernel.h>
#include "led.h"

#include <zephyr/logging/log.h>
LOG_MODULE_REGISTER(led, LOG_LEVEL_DBG);

static struct gpio_dt_spec led = GPIO_DT_SPEC_GET(DT_NODELABEL(led0), gpios);
static led_mode_t s_prev_mode = LED_OFF;
static led_mode_t s_curr_mode = LED_OFF;
static int s_timer_event_count = 0;

static void turn_on_led(){
   gpio_pin_set_dt(&led, 1);
}

static void turn_off_led(){
   gpio_pin_set_dt(&led, 0);
}


static void timer_handler(struct k_timer *dummy)
{
  s_timer_event_count++;
  if (s_curr_mode==LED_SLOW_FLASH){
    int v = s_timer_event_count % 5;
    if (v==1) {
      turn_off_led();
    } else if (v==0) {
      turn_on_led();
    }
  }else{
    gpio_pin_toggle_dt(&led);
  }
}

K_TIMER_DEFINE(s_timer, timer_handler, NULL);
static bool s_is_timer_on = false;

static void start_timer(bool is_slow){
  if (s_is_timer_on) {
     LOG_ERR("Led timer has already turned on");
     k_timer_stop(&s_timer);
  }

  if (is_slow) {
    k_timer_start(&s_timer, K_MSEC(1000), K_MSEC(1000));
  } else {
    k_timer_start(&s_timer, K_MSEC(200), K_MSEC(200));
  }

  s_is_timer_on = true;
}

static void stop_timer(void){
  if (!s_is_timer_on) {
     LOG_ERR("Led timer has already turned off");
  } else {
   k_timer_stop(&s_timer);
  }

  s_is_timer_on = false;
}

void led_init(void) {
  	int ret = gpio_pin_configure_dt(&led, GPIO_OUTPUT);
		if (ret != 0) {
			LOG_ERR("Error %d: failed to configure LED device %s pin %d\n",
			       ret, led.port->name, led.pin);
		}
}


static void enable_mode(led_mode_t mode) {
  switch(mode){
    case LED_ON:
      turn_on_led();
      break;

    case LED_QUICK_FLASH:
      turn_on_led();
      start_timer(false);
      break;

    case LED_SLOW_FLASH:
      turn_on_led();
      start_timer(true);
      break;

    case LED_OFF:
      /* passthrough */
    default:
      /* all invalid value will be treated as off */
      turn_off_led();
  }
}

static void disable_mode(led_mode_t mode) {
  switch(mode){
    case LED_QUICK_FLASH:
      /* passthrough */
    case LED_SLOW_FLASH:
      stop_timer();
      turn_off_led();
      break;

    default:
      /*do nothing*/
      NULL;
  }
}

void led_set(led_mode_t mode) {
  s_prev_mode = s_curr_mode;
  disable_mode(s_curr_mode);
  s_curr_mode = mode;
  enable_mode(mode);
}

void led_restore(void) {
  disable_mode(s_curr_mode);
  s_curr_mode = s_prev_mode;
  enable_mode(s_curr_mode);
  s_prev_mode = LED_OFF;
}
```

## src/led.h
```c
#ifndef __LED_H 
#define __LED_H

#include <stdbool.h>

typedef enum tag_led_mode {
  LED_OFF,
  LED_ON,
  LED_SLOW_FLASH,
  LED_QUICK_FLASH
} led_mode_t;

void led_init();
void led_set(led_mode_t mode);
void led_restore();

#endif
```

## src/nvsfs.c
```c
#include <zephyr/kernel.h>
#include <zephyr/sys/reboot.h>
#include <zephyr/device.h>
#include <string.h>
#include <zephyr/drivers/flash.h>
#include <zephyr/storage/flash_map.h>
#include <zephyr/fs/nvs.h>
#include "nvsfs.h"

#include <zephyr/logging/log.h>
LOG_MODULE_REGISTER(nvs, LOG_LEVEL_DBG);

static struct nvs_fs fs;

#define NVS_PARTITION		storage_partition
#define NVS_PARTITION_DEVICE	FIXED_PARTITION_DEVICE(NVS_PARTITION)
#define NVS_PARTITION_OFFSET	FIXED_PARTITION_OFFSET(NVS_PARTITION)

int nvsfs_init(void) {
  int rc;
  struct flash_pages_info info;

	/* define the nvs file system by settings with:
	 *	sector_size equal to the pagesize,
	 *	3 sectors
	 *	starting at NVS_PARTITION_OFFSET
	 */
	fs.flash_device = NVS_PARTITION_DEVICE;
	if (!device_is_ready(fs.flash_device)) {
		LOG_ERR("Flash device %s is not ready\n", fs.flash_device->name);
		return 0;
	}
	fs.offset = NVS_PARTITION_OFFSET;
	rc = flash_get_page_info_by_offs(fs.flash_device, fs.offset, &info);
	if (rc) {
		LOG_ERR("Unable to get page info, rc=%d\n", rc);
		return rc;
	}
	fs.sector_size = info.size;
	fs.sector_count = 3U;

	rc = nvs_mount(&fs);
	if (rc) {
		LOG_ERR("Flash Init failed, rc=%d\n", rc);
		return rc;
	}

  return 0;
}

ssize_t nvsfs_read(uint16_t id, void *data, size_t len) {
  int err = nvs_read(&fs, id, data, len);
  if (err<=0) {
    LOG_ERR("read key %d error code %d", id, err);
  }

  return err;
}

ssize_t nvsfs_write(uint16_t id, const void *data, size_t len) {
  int err = nvs_write(&fs, id, data, len);
  if (err<=0) {
    LOG_ERR("write key %d error code %d", id, err);
  }

  return err;
}

int nvsfs_delete(uint16_t id) {
  int err = nvs_delete(&fs, id);
  if (err<=0) {
    LOG_ERR("Delete key %d error code %d", id, err);
  }

  return err;
}
```

## src/nvsfs.h
```c
#ifndef __NVSFS_H 
#define __NVSFS_H

#include <zephyr/kernel.h>

int nvsfs_init(void);
ssize_t nvsfs_read(uint16_t id, void *data, size_t len);
ssize_t nvsfs_write(uint16_t id, const void *data, size_t len);
int nvsfs_delete(uint16_t id);

#endif
```
