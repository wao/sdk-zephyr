## prj.conf
```kconfig
# empty config
CONFIG_LOG=y
CONFIG_DEBUG=y
CONFIG_DEBUG_INFO=y
CONFIG_DEBUG_OPTIMIZATIONS=y
CONFIG_RTT_CONSOLE=y
CONFIG_USE_SEGGER_RTT=y
CONFIG_LOG_BACKEND_RTT=y
CONFIG_LOG_BACKEND_UART=n
```

## src/main.c
```c
/*
 * Copyright (c) 2019 Nordic Semiconductor ASA
 *
 * SPDX-License-Identifier: Apache-2.0
 */

#include <zephyr/kernel.h>
#include <zephyr/logging/log.h>
LOG_MODULE_REGISTER(minimal, LOG_LEVEL_DBG);


int main(void)
{
  while(1){
    LOG_INF("Hello World from minimal!\n");
    k_sleep(K_SECONDS(5));
  }

	return 0;
}
```
